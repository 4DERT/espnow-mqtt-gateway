## components/esp_time/Kconfig.projbuild
```kconfig
menu "ESP time component configuration"

    config ESP_TIME_NTP_SERVER
        string "NETP Server Address"
        default "0.europe.pool.ntp.org"
        help
            Enter the IP address or domain of the NETP server that the
            device will connect to.
    
    config ESP_TIME_TIME_ZONE
        string "Time Zone"
        default "CET-1CEST,M3.5.0/2,M10.5.0/3"
        help
            Set the time zone for the device according to the POSIX TZ format.
            For example, 'CET-1CEST,M3.5.0/2,M10.5.0/3' for Central European Time.
            More details about the format can be found in the POSIX systems documentation.
    
endmenu
    
```

## components/ethernet_module/Kconfig.projbuild
```kconfig
menu "Ethernet Module Configuration"
    choice ETHERNET_MODULE_USE_ETHERNET
        prompt "Ethernet Type"
        default ETHERNET_MODULE_USE_INTERNAL_ETHERNET if IDF_TARGET_ESP32
        default ETHERNET_MODULE_USE_DM9051 if !IDF_TARGET_ESP32
        help
            Select which kind of Ethernet will be used in the example.

        config ETHERNET_MODULE_USE_INTERNAL_ETHERNET
            depends on IDF_TARGET_ESP32
            select ETH_USE_ESP32_EMAC
            bool "Internal EMAC"
            help
                Select internal Ethernet MAC controller.

        config ETHERNET_MODULE_USE_DM9051
            bool "DM9051 Module"
            select ETH_USE_SPI_ETHERNET
            select ETH_SPI_ETHERNET_MODULE_DM9051
            help
                Select external SPI-Ethernet module.
    endchoice

    if ETHERNET_MODULE_USE_INTERNAL_ETHERNET
        choice ETHERNET_MODULE_ETH_PHY_MODEL
            prompt "Ethernet PHY Device"
            default ETHERNET_MODULE_ETH_PHY_LAN87XX
            help
                Select the Ethernet PHY device to use in the example.

            config ETHERNET_MODULE_ETH_PHY_IP101
                bool "IP101"
                help
                    IP101 is a single port 10/100 MII/RMII/TP/Fiber Fast Ethernet Transceiver.
                    Goto http://www.icplus.com.tw/pp-IP101G.html for more information about it.

            config ETHERNET_MODULE_ETH_PHY_RTL8201
                bool "RTL8201/SR8201"
                help
                    RTL8201F/SR8201F is a single port 10/100Mb Ethernet Transceiver with auto MDIX.
                    Goto http://www.corechip-sz.com/productsview.asp?id=22 for more information about it.

            config ETHERNET_MODULE_ETH_PHY_LAN87XX
                bool "LAN87XX"
                help
                    Below chips are supported:
                    LAN8710A is a small footprint MII/RMII 10/100 Ethernet Transceiver with HP Auto-MDIX and
                        flexPWR® Technology.
                    LAN8720A is a small footprint RMII 10/100 Ethernet Transceiver with HP Auto-MDIX Support.
                    LAN8740A/LAN8741A is a small footprint MII/RMII 10/100 Energy Efficient Ethernet Transceiver
                        with HP Auto-MDIX and flexPWR® Technology.
                    LAN8742A is a small footprint RMII 10/100 Ethernet Transceiver with HP Auto-MDIX and
                        flexPWR® Technology.
                    Goto https://www.microchip.com for more information about them.

            config ETHERNET_MODULE_ETH_PHY_DP83848
                bool "DP83848"
                help
                    DP83848 is a single port 10/100Mb/s Ethernet Physical Layer Transceiver.
                    Goto http://www.ti.com/product/DP83848J for more information about it.
        endchoice

        config ETHERNET_MODULE_ETH_MDC_GPIO
            int "SMI MDC GPIO number"
            default 23
            help
                Set the GPIO number used by SMI MDC.

        config ETHERNET_MODULE_ETH_MDIO_GPIO
            int "SMI MDIO GPIO number"
            default 18
            help
                Set the GPIO number used by SMI MDIO.
    endif

    if ETHERNET_MODULE_USE_DM9051
        config ETHERNET_MODULE_DM9051_SPI_HOST
            int "SPI Host Number"
            range 0 2
            default 1
            help
                Set the SPI host used to communicate with DM9051.

        config ETHERNET_MODULE_DM9051_SCLK_GPIO
            int "SPI SCLK GPIO number"
            range 0 33
            default 19
            help
                Set the GPIO number used by SPI SCLK.

        config ETHERNET_MODULE_DM9051_MOSI_GPIO
            int "SPI MOSI GPIO number"
            range 0 33
            default 23
            help
                Set the GPIO number used by SPI MOSI.

        config ETHERNET_MODULE_DM9051_MISO_GPIO
            int "SPI MISO GPIO number"
            range 0 33
            default 25
            help
                Set the GPIO number used by SPI MISO.

        config ETHERNET_MODULE_DM9051_CS_GPIO
            int "SPI CS GPIO number"
            range 0 33
            default 22
            help
                Set the GPIO number used by SPI CS.

        config ETHERNET_MODULE_DM9051_SPI_CLOCK_MHZ
            int "SPI clock speed (MHz)"
            range 20 80
            default 20
            help
                Set the clock speed (MHz) of SPI interface.

        config ETHERNET_MODULE_DM9051_INT_GPIO
            int "Interrupt GPIO number"
            default 4
            help
                Set the GPIO number used by DM9051 interrupt.
    endif

    config ETHERNET_MODULE_ETH_PHY_RST_GPIO
        int "PHY Reset GPIO number"
        default -1
        help
            Set the GPIO number used to reset PHY chip.
            Set to -1 to disable PHY chip hardware reset.

    config ETHERNET_MODULE_ETH_PHY_ADDR
        int "PHY Address"
        range 0 31 if ETHERNET_MODULE_USE_INTERNAL_ETHERNET
        range 1 1 if !ETHERNET_MODULE_USE_INTERNAL_ETHERNET
        default 0
        help
            Set PHY address according your board schematic.

    config ETHERNET_MODULE_ETH_PIN_PHY_POWER
        int "PHY eth power GPIO number"
        default 12
        help
            Set the GPIO number used to enable PHY chip.
    

endmenu
```

## main/Kconfig.projbuild
```kconfig
menu "Application configuration"

  menu "ESP NOW"

    config ESP_NOW_USE_CUSTOM_MAC
      bool "Set custom ESPNOW MAC address"
      default n
      help
        Enable this option if you want to set a custom ESPNOW MAC address.

    if ESP_NOW_USE_CUSTOM_MAC

    config ESP_NOW_MAC_ADDR
      string "Custom MAC address"
      default "00:00:00:00:00:00"
      help
        Enter the custom MAC address in format XX:XX:XX:XX:XX:XX.
        The address must be valid and unique in the network.

    endif

    config ESP_NOW_CHANNEL
      int "ESP-NOW Channel"
      default 1
      help
        Specify the Wi-Fi channel to be used for ESP-NOW communication.

    config ESP_NOW_SEND_QUEUE_SIZE
      int "ESP-NOW Send Queue Size"
      default 5
      help
        Set the size of the queue used for sending ESP-NOW messages.

    config ESP_NOW_RECIEVE_QUEUE_SIZE
      int "ESP-NOW Receive Queue Size"
      default 5
      help
        Set the size of the queue used for receiving ESP-NOW messages.

    config ESP_NOW_RESULT_QUEUE_SIZE
      int "ESP-NOW Result Queue Size"
      default 2
      help
        Set the size of the queue used for storing ESP-NOW send result statuses.

  endmenu

  menu "Device Management Configuration"

    config GW_DEVICE_LIST_SIZE
      int "Maximum Number of Paired Devices"
      default 32
      help
        Specify the maximum number of devices that can be paired with the gateway.

    config DIC_DEVICE_LIST_SIZE
      int "Maximum Number of Devices in Device List"
      default 64
      help
        Specify the maximum number of devices that can be tracked by the Device Information Collector (DIC).
        This value should be greater than the maximum number of paired devices (GW_DEVICE_LIST_SIZE).

    config DIC_DEVICE_QUEUE_SIZE
      int "Device Queue Size"
      default 3
      help
        Set the size of the queue used by the Device Information Collector (DIC) for processing incoming device information.

  endmenu

  menu "MQTT Configuration"

    config MQTT_WAIT_FOR_CONNECTION_MS
      int "MQTT Connection Timeout (ms)"
      default 10000
      help
        Specify the timeout in milliseconds to wait for a connection to the MQTT broker.

    config MQTT_OUTBOX_LIMIT
      int "MQTT Outbox Limit"
      default 25
      help
        Set the maximum number of messages that can be stored in the MQTT outbox. 
        This limits the number of unsent messages buffered while awaiting successful transmission.

  endmenu

  menu "Settings Configuration"

    config SETTINGS_MAX_STR_LENGTH
      int "Maximum Web Settings Field Length"
      default 32
      help
        Specify the maximum length for string fields in settings, such as MQTT address, username, password, and topic.

  endmenu

  menu "Filesystem Configuration"

    config FLASH_BASE_PATH
      string "Base Path for Flash Storage"
      default "/storage"
      help
        Specify the base path in the filesystem where the flash storage is mounted.
        This path is used as the root directory for storing configuration and device data.

    config SETTINGS_FILE_PATH
      string "Path to Settings File"
      default "/storage/settings.bin"
      help
        Specify the file path where the settings configuration file is stored in flash memory.

    config GW_DEVICE_LIST_FILE_PATH
      string "Path to Gateway Device List File"
      default "/storage/device_list.bin"
      help
        Specify the file path where the list of paired devices for the gateway is stored in flash memory.

  endmenu

endmenu
```

## sdkconfig.defaults
```kconfig
CONFIG_ESPTOOLPY_FLASHSIZE_4MB=y
CONFIG_PARTITION_TABLE_CUSTOM=y
CONFIG_ETH_RMII_CLK_OUTPUT=y
CONFIG_ETH_DMA_BUFFER_SIZE=1524
CONFIG_ETH_DMA_RX_BUFFER_NUM=4
CONFIG_ETH_DMA_TX_BUFFER_NUM=4
# CONFIG_ETH_USE_SPI_ETHERNET is not set
CONFIG_HTTPD_MAX_REQ_HDR_LEN=1024
CONFIG_ESP_DEFAULT_CPU_FREQ_MHZ_240=y
```
